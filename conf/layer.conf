## conf/layer.conf
```bitbake
# We have a conf and classes directory, add to BBPATH
BBPATH =. "${LAYERDIR}:"

# We have a packages directory, add to BBFILES
BBFILES += "${LAYERDIR}/recipes-*/*/*.bb \
            ${LAYERDIR}/recipes-*/*/*.bbappend"

BBFILE_COLLECTIONS += "meta-tensorflow"
BBFILE_PATTERN_meta-tensorflow = "^${LAYERDIR}/"
BBFILE_PRIORITY_meta-tensorflow = "10"

LAYERVERSION_meta-tensorflow = "1"

LAYERSERIES_COMPAT_meta-tensorflow = "thud warrior zeus"

LAYERDEPENDS_meta-tensorflow = " \
    core \
    meta-python \
    openembedded-layer \
"

LAYER_PATH_meta-tensorflow = "${LAYERDIR}"
```

## meta-demo/conf/layer.conf
```bitbake
# We have a conf and classes directory, add to BBPATH
BBPATH .= ":${LAYERDIR}"

# We have recipes-* directories, add to BBFILES
BBFILES += "${LAYERDIR}/recipes-*/*/*.bb ${LAYERDIR}/recipes-*/*/*.bbappend"

BBFILE_COLLECTIONS += "tensorflow-demo"
BBFILE_PATTERN_tensorflow-demo = "^${LAYERDIR}/"
BBFILE_PRIORITY_tensorflow-demo = "1"

# This should only be incremented on significant changes that will
# cause compatibility issues with other layers
LAYERVERSION_tensorflow-demo = "1"

LAYERDEPENDS_tensorflow-demo = " \
    core \
    openembedded-layer \
    meta-tensorflow \
"

LAYERSERIES_COMPAT_tensorflow-demo = "thud warrior zeus"

# USB webcam
KERNEL_CLASSES_append = " ${@bb.utils.contains('DISTRO_FEATURES', 'ts-demo', 'ts-demo-kernel', '', d)}"
```
